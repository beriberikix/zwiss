## Kconfig
```kconfig
# SPDX-License-Identifier: Apache-2.0

mainmenu "Zwiss options"

source "Kconfig.zephyr"
```

## west.yml
```yaml
# SPDX-License-Identifier: Apache-2.0

manifest:
  self:
    path: app

  remotes:
    - name: zephyrproject-rtos
      url-base: https://github.com/zephyrproject-rtos

  projects:
    - name: zephyr
      remote: zephyrproject-rtos
      revision: main
      import:
        path-prefix: deps
        name-allowlist:
          - zephyr
          - cmsis
          - hal_atmel
          - hal_espressif
          - hal_gigadevice
          - hal_infineon
          - hal_microchip
          - hal_nordic
          - hal_nxp
          - hal_rpi_pico
          - hal_silabs
          - hal_st
          - hal_stm32
```
